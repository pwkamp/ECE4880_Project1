## firmware/main/Kconfig.projbuild
```kconfig
menu "Thermometer Configuration"
    choice THERMOMETER_SENSOR_BACKEND
        prompt "Temperature sensor backend"
        default THERMOMETER_SENSOR_BACKEND_REAL

        config THERMOMETER_SENSOR_BACKEND_FAKE
            bool "Deterministic simulated sensors"

        config THERMOMETER_SENSOR_BACKEND_REAL
            bool "Two DS18B20 sensors on GPIO14/GPIO27"
    endchoice

    choice THERMOMETER_DISPLAY_BACKEND
        prompt "Local display backend"
        default THERMOMETER_DISPLAY_BACKEND_REAL

        config THERMOMETER_DISPLAY_BACKEND_LED
            bool "On-board LED display simulator"

        config THERMOMETER_DISPLAY_BACKEND_REAL
            bool "HD44780 LCD and physical sensor buttons"
    endchoice

    config THERMOMETER_LED_GPIO
        int "LED display-simulator GPIO"
        depends on THERMOMETER_DISPLAY_BACKEND_LED
        range 0 48
        default 2

    config THERMOMETER_LED_ACTIVE_LOW
        bool "LED display simulator is active-low"
        depends on THERMOMETER_DISPLAY_BACKEND_LED
        default n
endmenu
```

## firmware/sdkconfig.defaults
```kconfig
CONFIG_BT_ENABLED=y
CONFIG_BT_NIMBLE_ENABLED=y
CONFIG_BT_NIMBLE_MAX_CONNECTIONS=1
CONFIG_BT_NIMBLE_STATIC_PASSKEY=y
CONFIG_BT_NIMBLE_ROLE_CENTRAL=n
CONFIG_BT_NIMBLE_ROLE_OBSERVER=n
CONFIG_BT_NIMBLE_ROLE_BROADCASTER=n
CONFIG_BT_NIMBLE_ROLE_PERIPHERAL=y
CONFIG_BT_NIMBLE_GATT_SERVER=y
CONFIG_BT_NIMBLE_SECURITY_ENABLE=y
CONFIG_BT_NIMBLE_SM_SC=y
CONFIG_BT_NIMBLE_SM_SC_ONLY=1
# CONFIG_BT_NIMBLE_SM_LEGACY is not set
CONFIG_BT_NIMBLE_NVS_PERSIST=y
CONFIG_BT_NIMBLE_MAX_BONDS=1
CONFIG_BT_NIMBLE_MAX_CCCDS=0
# CONFIG_BT_NIMBLE_DTM_MODE_TEST is not set
CONFIG_BT_NIMBLE_PROX_SERVICE=n
CONFIG_BT_NIMBLE_ANS_SERVICE=n
CONFIG_BT_NIMBLE_CTS_SERVICE=n
CONFIG_BT_NIMBLE_HTP_SERVICE=n
CONFIG_BT_NIMBLE_IPSS_SERVICE=n
CONFIG_BT_NIMBLE_TPS_SERVICE=n
CONFIG_BT_NIMBLE_IAS_SERVICE=n
CONFIG_BT_NIMBLE_LLS_SERVICE=n
CONFIG_BT_NIMBLE_SPS_SERVICE=n
CONFIG_BT_NIMBLE_HR_SERVICE=n
CONFIG_BT_NIMBLE_BAS_SERVICE=n
CONFIG_BT_NIMBLE_DIS_SERVICE=n

# Let the CPU scale down and enter tickless idle between the 1 Hz samples.
CONFIG_PM_ENABLE=y
CONFIG_FREERTOS_USE_TICKLESS_IDLE=y
CONFIG_BTDM_CTRL_MODEM_SLEEP=y
CONFIG_BTDM_CTRL_MODEM_SLEEP_MODE_ORIG=y
CONFIG_BTDM_CTRL_LPCLK_SEL_MAIN_XTAL=y

# Production defaults: smaller firmware and quieter UART wakeups.
CONFIG_COMPILER_OPTIMIZATION_SIZE=y
CONFIG_LOG_DEFAULT_LEVEL_WARN=y
CONFIG_LOG_DEFAULT_LEVEL=2

# Sensor and display backends are selected independently.
CONFIG_THERMOMETER_SENSOR_BACKEND_FAKE=y
CONFIG_THERMOMETER_DISPLAY_BACKEND_LED=y
```
